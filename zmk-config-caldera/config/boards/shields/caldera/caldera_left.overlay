#include "caldera.dtsi"

&kscan0 {
    col-gpios
        = <&pro_micro 12 GPIO_ACTIVE_HIGH>
        , <&pro_micro 25 GPIO_ACTIVE_HIGH>
        , <&pro_micro 2 GPIO_ACTIVE_HIGH>
        , <&pro_micro 15 GPIO_ACTIVE_HIGH>
        , <&pro_micro 4 GPIO_ACTIVE_HIGH>
        , <&pro_micro 13 GPIO_ACTIVE_HIGH>
        ;
};

